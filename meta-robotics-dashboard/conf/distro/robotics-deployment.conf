## meta-robotics-dashboard/conf/distro/robotics-deployment.conf
```bitbake
# robotics-dashboard.conf

DISTRO = "robotics-dashboard"
DISTRO_NAME = "Robotics Dashboard Distro"
DISTRO_VERSION = "0.1"
LICENSE_FLAGS_ACCEPTED = "synaptics-killswitch"
INIT_MANAGER = "systemd"
DISTRO_FEATURES:append = " systemd virtualization"
VIRTUAL-RUNTIME_init_manager = "systemd"
```

## meta-robotics-dashboard/conf/layer.conf
```bitbake
# We have a conf and classes directory, add to BBPATH
BBPATH .= ":${LAYERDIR}"

# We have recipes-* directories, add to BBFILES
BBFILES += "${LAYERDIR}/recipes-*/*/*.bb \
            ${LAYERDIR}/recipes-*/*/*.bbappend"

BBFILE_COLLECTIONS += "meta-robotics-dashboard"
BBFILE_PATTERN_meta-robotics-dashboard = "^${LAYERDIR}/"
BBFILE_PRIORITY_meta-robotics-dashboard = "25"

LAYERDEPENDS_meta-robotics-dashboard = "core"
LAYERSERIES_COMPAT_meta-robotics-dashboard = "mickledore"
```
